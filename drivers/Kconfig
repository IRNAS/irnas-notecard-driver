## drivers/notecard/Kconfig
```kconfig
menuconfig NOTECARD
	bool "Blues Notecard driver"
	default y
	depends on DT_HAS_BLUES_NOTECARD_ENABLED
	help
        Enable driver for Notecard

if NOTECARD

config NOTECARD_HEAP_SIZE
	int "Heap buffer size"
    default 4096
	help
        Controls the size of static heap, used by note-c library.

config NOTECARD_INIT_PRIORITY
	int "Init priority"
	default 70
	help
	  Device driver initialization priority.

module = NOTECARD
module-str = notecard
source "subsys/logging/Kconfig.template.log_config"

endif
```

## dts/bindings/blues,notecard-i2c.yaml
```yaml
# COPYRIGHT NOTICE: (c) 2022 Irnas. All rights reserved.
# Author: Marko Sagadin <marko@irnas.eu>

description: |
  Implementation of driver for Blues Wireless' Notecard communication modules accessed through I2C bus

compatible: "blues,notecard"

include: ["i2c-device.yaml", "blues,notecard-common.yaml"]
```

## dts/bindings/blues,notecard-uart.yaml
```yaml
# COPYRIGHT NOTICE: (c) 2022 Irnas. All rights reserved.
# Author: Marko Sagadin <marko@irnas.eu>

description: |
  Implementation of driver for Blues Wireless' Notecard communication modules accessed through UART bus

compatible: "blues,notecard"

include: ["uart-device.yaml", "blues,notecard-common.yaml"]
```

## dts/bindings/irnas,notecard-common.yaml
```yaml
# COPYRIGHT NOTICE: (c) 2022 Irnas. All rights reserved.
# Author: Marko Sagadin <marko@irnas.eu>

properties:
  attn-p-gpios:
    type: phandle-array
    required: false
    description: |
      ATTN_P - Attention pin 

      Pin controlled by Notecard used to inform the host MCU of certain 
      asynchronous events (such as incoming data availability, or Notecard 
      motion) in an interrupt-driven manner rather than just polling.
```

## dts/bindings/irnas,notecard-i2c.yaml
```yaml
# COPYRIGHT NOTICE: (c) 2022 Irnas. All rights reserved.
# Author: Marko Sagadin <marko@irnas.eu>

description: |
  IRNAS implementation of driver for Blues Wireless' Notecard communication modules accessed through I2C bus

compatible: "irnas,notecard"

include: ["i2c-device.yaml", "irnas,notecard-common.yaml"]
```

## dts/bindings/irnas,notecard-uart.yaml
```yaml
# COPYRIGHT NOTICE: (c) 2022 Irnas. All rights reserved.
# Author: Marko Sagadin <marko@irnas.eu>

description: |
  IRNAS implementation of driver for Blues Wireless' Notecard communication modules accessed through UART bus

compatible: "irnas,notecard"

include: ["uart-device.yaml", "irnas,notecard-common.yaml"]
```

## samples/interrupt/sample.yaml
```yaml
sample:
  name: Interrupt sample
common:
  sysbuild: true
  tags: quick_build
  platform_allow:
    - nrf52840dk/nrf52840
tests:
  samples.interrupt.i2c:
    extra_args:
      - DTC_OVERLAY_FILE=notecard_over_i2c.overlay
  samples.interrupt.uart:
    extra_args:
      - DTC_OVERLAY_FILE=notecard_over_uart.overlay
```

## samples/version_test/sample.yaml
```yaml
sample:
  name: Version test sample
common:
  sysbuild: true
  tags: quick_build
  platform_allow:
    - nrf52840dk/nrf52840
tests:
  samples.version_test.i2c:
    extra_args:
      - DTC_OVERLAY_FILE=notecard_over_i2c.overlay
  samples.version_test.uart:
    extra_args:
      - DTC_OVERLAY_FILE=notecard_over_uart.overlay
```

## third-party/Kconfig
```kconfig
menuconfig NOTE_C_LIB
	bool "note-c library"

	help
        Enable compilation of note-c library
```
